## configs/arb2_defconfig
```kconfig
# architecture
BR2_arm=y
BR2_cortex_a9=y

# patches
BR2_GLOBAL_PATCH_DIR="board/arb2/patches"

# Linux headers same as kernel, a 4.1 series
BR2_PACKAGE_HOST_LINUX_HEADERS_CUSTOM_4_1=y

# system
BR2_TARGET_GENERIC_GETTY_PORT="ttymxc4"

# kernel
BR2_LINUX_KERNEL=y
BR2_LINUX_KERNEL_CUSTOM_GIT=y
BR2_LINUX_KERNEL_CUSTOM_REPO_URL="git://github.com/hefloryd/linux-2.6-imx.git"
BR2_LINUX_KERNEL_CUSTOM_REPO_VERSION="arb2"
BR2_LINUX_KERNEL_DEFCONFIG="imx_v7"
BR2_LINUX_KERNEL_DTS_SUPPORT=y
BR2_LINUX_KERNEL_INTREE_DTS_NAME="imx6dl-arb2"

# filesystem
BR2_ROOTFS_POST_IMAGE_SCRIPT="board/arb2/post-image.sh"
BR2_TARGET_ROOTFS_CPIO=y
BR2_TARGET_ROOTFS_CPIO_GZIP=y
BR2_TARGET_ROOTFS_INITRAMFS=y

# target packages
BR2_PACKAGE_IMX_LIB=y
BR2_PACKAGE_IMX_VPU=y
BR2_PACKAGE_IMX_TEST=y
BR2_PACKAGE_FREESCALE_IMX_PLATFORM_IMX6Q=y

# host tools
BR2_PACKAGE_HOST_DTC=y

# bootloader
BR2_TARGET_UBOOT=y
BR2_TARGET_UBOOT_BOARDNAME="arb2"
BR2_TARGET_UBOOT_FORMAT_IMX=y
BR2_TARGET_UBOOT_CUSTOM_GIT=y
BR2_TARGET_UBOOT_CUSTOM_REPO_URL="git://github.com/hefloryd/uboot-imx.git"
BR2_TARGET_UBOOT_CUSTOM_REPO_VERSION="arb2"
```

## package/imx-test/Config.in
```kconfig
config BR2_PACKAGE_IMX_TEST
	bool "imx-test"
        depends on BR2_PACKAGE_IMX_VPU
        depends on BR2_PACKAGE_IMX_LIB
	help
	  Build imx-test

	  https://github.com/Freescale
```
